## boards/shields/moNa2/Kconfig.defconfig
```kconfig
if SHIELD_MONA2_R

    config ZMK_KEYBOARD_NAME
        default "moNa2"

    config ZMK_BLE
        default y

    config ZMK_SPLIT_ROLE_CENTRAL
        default y

    config INPUT
        default y

    config ZMK_POINTING
        default y

    config SPI
        default y

    config PMW3610
        default y

    if ZMK_DISPLAY
        config I2C
            default y

        config SSD1306
            default y
    endif # ZMK_DISPLAY

    if LVGL
        config LV_Z_VDB_SIZE
            default 64

        config LV_DPI_DEF
            default 148

        config LV_Z_BITS_PER_PIXEL
            default 1

        choice LV_COLOR_DEPTH
            default LV_COLOR_DEPTH_1
        endchoice
    endif # LVGL
    
endif

if SHIELD_MONA2_L

    config ZMK_POINTING
        default y

endif

if SHIELD_MONA2_R || SHIELD_MONA2_L

    config NFCT_PINS_AS_GPIOS
        default y

    config ZMK_SPLIT
        default y

    config RGBLED_WIDGET_BATTERY_LEVEL_HIGH
        default 30

    config RGBLED_WIDGET_BATTERY_LEVEL_CRITICAL
        default 10

endif
```

## boards/shields/moNa2/Kconfig.shield
```kconfig
config SHIELD_MONA2_R
    def_bool $(shields_list_contains,mona2_r)

config SHIELD_MONA2_L
    def_bool $(shields_list_contains,mona2_l)
```

## boards/shields/moNa2a/Kconfig.shield
```kconfig
config SHIELD_MONA2_R
    def_bool $(shields_list_contains,moNa2_R)

config SHIELD_MONA2_L
    def_bool $(shields_list_contains,moNa2_L)
```

## boardsa/shields/moNa2/Kconfig.shield
```kconfig
config SHIELD_mona2_R
    def_bool $(shields_list_contains,mona2_r)

config SHIELD_mona2_L
    def_bool $(shields_list_contains,mona2_l)
```

## config/west.yml
```yaml
manifest:
  remotes:
    - name: zmkfirmware
      url-base: https://github.com/zmkfirmware
    - name: sayu-hub
      url-base: https://github.com/sayu-hub
    - name: badjeff    # <-- PMW3610
      url-base: https://github.com/badjeff
    - name: caksoylar  # <-- RGB LED
      url-base: https://github.com/caksoylar  
    - name: mctechnology17
      url-base: https://github.com/mctechnology17
    - name: te9no  # <-- Input Processor Keybind
      url-base: https://github.com/te9no
    - name: kot149
      url-base: https://github.com/kot149
  projects:
    - name: zmk
      remote: te9no
      revision: main
      import: app/west.yml
    - name: zmk-pmw3610-driver
      remote: badjeff
      revision: main
    - name: zmk-analog-input-driver
      remote: badjeff
      revision: main
    - name: zmk-nice-oled
      remote: mctechnology17
      revision: main
    - name: zmk-rgbled-widget
      remote: caksoylar
      revision: main
    - name: zmk-input-processor-keybind
      remote: te9no
      revision: main
    - name: zmk-layout-shift
      remote: kot149
      revision: v1
  self:
    path: config
```
